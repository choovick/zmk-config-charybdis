/*
 * Copyright (c) 2024 The ZMK Contributors
 * SPDX-License-Identifier: MIT
 * 
 * Charybdis right keyboard - Peripheral mode (for use with dongle)
 * Forwards trackball input to central device
 */

#include "charybdis_right_common.dtsi"

/ {
    // Forward trackball input from peripheral to central (dongle)
    input_split: input_split@0 {
        compatible = "zmk,input-split";
        status = "okay";
        device = <&trackball>;
        reg = <0 1>;  // address 0, size 1
    };
};
