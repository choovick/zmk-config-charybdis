#include "dongle_common.dtsi"

/ {
	kscan0: kscan {
		compatible = "zmk,kscan-gpio-direct";
		label = "KSCAN";
		input-gpios = <&pro_micro 0 (GPIO_ACTIVE_LOW | GPIO_PULL_UP)>;
	};
};

// I2C for OLED on nice!nano
&pro_micro_i2c {
	status = "okay";
};

