## boards/shields/charybdis/Kconfig.defconfig
```kconfig
if SHIELD_CHARYBDIS_RIGHT_STANDALONE

config ZMK_KEYBOARD_NAME
	default "Charybdis"

config ZMK_SPLIT_BLE_ROLE_CENTRAL
	default y

endif

if SHIELD_DONGLE_CHARYBDIS_RIGHT

config ZMK_KEYBOARD_NAME
	default "Charybdis Right"

endif

if SHIELD_DONGLE_PROSPECTOR || SHIELD_DONGLE_BWSHOCKLEY_PROSPECTOR

config ZMK_KEYBOARD_NAME
	default "Charybdis"

config ZMK_SPLIT_BLE_ROLE_CENTRAL
	default y

endif

if SHIELD_DONGLE_NICE

config ZMK_KEYBOARD_NAME
	default "Charybdis"

config ZMK_SPLIT_BLE_ROLE_CENTRAL
	default y

endif



if SHIELD_CHARYBDIS_LEFT || SHIELD_CHARYBDIS_RIGHT_STANDALONE || SHIELD_DONGLE_CHARYBDIS_RIGHT || SHIELD_DONGLE_PROSPECTOR || SHIELD_DONGLE_NICE || SHIELD_DONGLE_BWSHOCKLEY_PROSPECTOR

config ZMK_SPLIT
	default y

endif
```

## boards/shields/charybdis/Kconfig.shield
```kconfig
config SHIELD_CHARYBDIS_LEFT
	def_bool $(shields_list_contains,charybdis_left)

config SHIELD_CHARYBDIS_RIGHT_STANDALONE
	def_bool $(shields_list_contains,charybdis_right_standalone)

config SHIELD_DONGLE_CHARYBDIS_RIGHT
	def_bool $(shields_list_contains,dongle_charybdis_right)

config SHIELD_DONGLE_PROSPECTOR
	def_bool $(shields_list_contains,dongle_prospector)

config SHIELD_DONGLE_BWSHOCKLEY_PROSPECTOR
	def_bool $(shields_list_contains,dongle_bwshockley_prospector)

config SHIELD_DONGLE_NICE
	def_bool $(shields_list_contains,dongle_nice)
```

## config/boards/shields/charybdis/Kconfig.defconfig
```kconfig
if SHIELD_CHARYBDIS_RIGHT_STANDALONE

config ZMK_KEYBOARD_NAME
	default "Charybdis"

config ZMK_SPLIT_BLE_ROLE_CENTRAL
	default y

endif

if SHIELD_CHARYBDIS_RIGHT_DONGLE

config ZMK_KEYBOARD_NAME
	default "Charybdis Right"

endif

if SHIELD_PROSPECTOR_DONGLE

config ZMK_KEYBOARD_NAME
	default "Charybdis"

config ZMK_SPLIT_BLE_ROLE_CENTRAL
	default y

endif

if SHIELD_CHARYBDIS_LEFT || SHIELD_CHARYBDIS_RIGHT_STANDALONE || SHIELD_CHARYBDIS_RIGHT_DONGLE || SHIELD_PROSPECTOR_DONGLE

config ZMK_SPLIT
	default y

endif
```

## config/boards/shields/charybdis/Kconfig.shield
```kconfig
config SHIELD_CHARYBDIS_LEFT
	def_bool $(shields_list_contains,charybdis_left)

config SHIELD_CHARYBDIS_RIGHT_STANDALONE
	def_bool $(shields_list_contains,charybdis_right_standalone)

config SHIELD_CHARYBDIS_RIGHT_DONGLE
	def_bool $(shields_list_contains,charybdis_right_dongle)

config SHIELD_PROSPECTOR_DONGLE
	def_bool $(shields_list_contains,prospector_dongle)
```

## config/west.yml
```yaml
manifest:
  remotes:
  - name: zmkfirmware
    url-base: https://github.com/zmkfirmware
  - name: badjeff
    url-base: https://github.com/badjeff
  - name: carrefinho
    url-base: https://github.com/carrefinho
  - name: englmaxi
    url-base: https://github.com/englmaxi
  # janpfischer remote disabled - zmk-dongle-screen has Zephyr 4.1 compatibility issues
  # - name: janpfischer
  #   url-base: https://github.com/janpfischer
  projects:
  - name: zmk
    remote: zmkfirmware
    revision: main
    import: app/west.yml
  - name: zmk-pmw3610-driver
    remote: badjeff
    revision: zmk-0.4
  - name: prospector-zmk-module
    remote: carrefinho
    revision: feat/new-status-screens
  - name: zmk-dongle-display
    remote: englmaxi
    revision: main
  # zmk-dongle-screen disabled - Zephyr 4.1 compatibility issues pending upstream fix
  # See: https://github.com/janpfischer/zmk-dongle-screen/issues/29
  # - name: zmk-dongle-screen
  #   remote: janpfischer
  #   revision: upgrade-4.1
  self:
    path: config
```

## dts/bindings/behaviors/zmk,behavior-rgb-local.yaml
```yaml
description: RGB underglow behavior with central-authoritative split synchronization
compatible: "zmk,behavior-rgb-local"
include: two_param.yaml
```
