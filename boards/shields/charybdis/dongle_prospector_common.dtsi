#include "dongle_common.dtsi"

/ {
	kscan0: kscan {
		compatible = "zmk,kscan-gpio-demux";
		label = "KSCAN";
		input-gpios = <&xiao_d 0 (GPIO_ACTIVE_LOW | GPIO_PULL_UP)>;
		output-gpios
			= <&xiao_d 1 GPIO_ACTIVE_HIGH>
			, <&xiao_d 2 GPIO_ACTIVE_HIGH>
			;
	};
};

